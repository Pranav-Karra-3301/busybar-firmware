# STM32U5Gx register map
File version: 1.0
CPU: CM33 r0p1, little endian, MPU, FPU, 4 interrupt priority bits
Registers are 32-bit, read-write, reset 0x0 unless marked. A register's access mark holds for its fields unless they carry their own. Offsets are from the block's base; lines under a group give offsets from that group; [hi:lo] are bit positions; {n}, {i} and the like mark numbered series; 'fields as' and 'values as' point back to an identical list; <NAME> marks a mode.

## Memory map
0x40000000 TIM2 size 0x400 — General-purpose-timers
0x40000400 TIM3 size 0x400
0x40000800 TIM4 size 0x400
0x40000C00 TIM5 size 0x400
0x40001000 TIM6 size 0x400 — General-purpose-timers
0x40001400 TIM7 size 0x400
0x40002C00 WWDG size 0x400 — System window watchdog
0x40003000 IWDG size 0x400 — Independent watchdog
0x40003800 SPI2 size 0x400
0x40004400 USART2 size 0x400
0x40004800 USART3 size 0x400
0x40004C00 UART4 size 0x400
0x40005000 UART5 size 0x400
0x40005400 I2C1 size 0x400 — Inter-integrated circuit
0x40005800 I2C2 size 0x400
0x40006000 CRS size 0x400 — Clock recovery system
0x40006400 USART6 size 0x400
0x40008400 I2C4 size 0x400
0x40009400 LPTIM2 size 0x400
0x40009800 I2C5 size 0x400
0x40009C00 I2C6 size 0x400
0x4000A400 FDCAN1 size 0x400
0x4000AC00 FDCAN1_RAM size 0x400
0x4000DC00 UCPD1 size 0x400 — USB Power Delivery interface
0x40012C00 TIM1 size 0x400 — Advanced-timers
0x40013000 SPI1 size 0x400 — Serial peripheral interface
0x40013400 TIM8 size 0x400
0x40013800 USART1 size 0x400 — Universal synchronous asynchronous receiver transmitter
0x40014000 TIM15 size 0x400 — General purpose timers
0x40014400 TIM16 size 0x400 — General purpose timers
0x40014800 TIM17 size 0x400
0x40015400 SAI1 size 0x400 — Serial audio interface
0x40015800 SAI2 size 0x400
0x40016400 GFXTIM size 0x400 — GFXTIM register block
0x40016800 LTDC size 0x400
0x40016C00 DSI size 0x1000
0x40020000 GPDMA1 size 0x1000
0x40021000 CORDIC size 0x400 — CORDIC Co-processor
0x40021400 FMAC size 0x400 — Filter Math Accelerator
0x40022000 FLASH size 0x400
0x40023000 CRC size 0x400 — Cyclic redundancy check calculation unit
0x40024000 TSC size 0x400 — Touch sensing controller
0x40025000 MDF1 size 0x1000 — Multi-function digital filter
0x40026000 RAMCFG size 0x1000
0x4002A000 JPEG size 0x1000 — JPEG address block description
0x4002B000 DMA2D size 0xC00 — DMA2D controller
0x4002C000 GFXMMU size 0x3000
0x40030400 ICache size 0x400
0x40031400 DCACHE1 size 0x400
0x40031800 DCACHE2 size 0x400
0x40032400 GTZC1_TZSC size 0x400
0x40032800 GTZC1_TZIC size 0x400
0x40032C00 GTZC1_MPCBB1 size 0x400
0x40033000 GTZC1_MPCBB2 size 0x400
0x40033400 GTZC1_MPCBB3 size 0x400
0x40033800 GTZC1_MPCBB5 size 0x400
0x40033C00 GTZC1_MPCBB6 size 0x400
0x42020000 GPIOA size 0x400 — General-purpose I/Os
0x42020400 GPIOB size 0x400 — General-purpose I/Os
0x42020800 GPIOC size 0x400 — General-purpose I/Os
0x42020C00 GPIOD size 0x400
0x42021000 GPIOE size 0x400
0x42021400 GPIOF size 0x400
0x42021800 GPIOG size 0x400
0x42021C00 GPIOH size 0x400 — General-purpose I/Os
0x42022000 GPIOI size 0x400 — General-purpose I/Os
0x42022400 GPIOJ size 0x400 — General-purpose I/Os
0x42028000 ADC1 size 0xCC
0x42028100 ADC2 size 0xCC
0x42028300 ADC12_Common size 0x14 — Analog-to-Digital Converter
0x4202C000 DCMI size 0x400 — Digital camera interface
0x4202C400 PSSI size 0x400
0x42040000 OTG_HS size 0x20000
0x420C0000 AES size 0x400 — Advanced encryption standard hardware accelerator
0x420C0400 HASH size 0x400 — Hash processor
0x420C0800 RNG size 0x400 — Random number generator
0x420C0C00 SAES size 0x400 — Secure AES coprocessor
0x420C2000 PKA size 0x2000 — Private key accelerator
0x420C4000 OCTOSPIM size 0x400 — OCTOSPI I/O manager
0x420C5000 OTFDEC1 size 0x400 — On-The-Fly Decryption engine
0x420C5400 OTFDEC2 size 0x400
0x420C8000 SDMMC1 size 0x400 — Secure digital input/output MultiMediaCard interface
0x420C8400 DLYBSD1 size 0x400
0x420C8800 DLYBSD2 size 0x400
0x420C8C00 SDMMC2 size 0x400
0x420CF000 DLYBOS1 size 0x400 — The delay block (DLYB) is used to generate an output clock that is dephased from the input clock
0x420CF400 DLYBOS2 size 0x400
0x420D0400 FMC size 0x400
0x420D1400 OCTOSPI1 size 0x400 — OctoSPI
0x420D2400 OCTOSPI2 size 0x400
0x420D3400 HSPI1 size 0x400
0x46000400 SYSCFG size 0x400 — System configuration controller
0x46002000 SPI3 size 0x400
0x46002400 LPUART1 size 0x400 — Universal synchronous asynchronous receiver transmitter
0x46002800 I2C3 size 0x400
0x46004400 LPTIM1 size 0x400 — Low power timer
0x46004800 LPTIM3 size 0x400
0x46004C00 LPTIM4 size 0x400 — Low power timer
0x46005000 OPAMP size 0x400 — Operational amplifiers
0x46005400 COMP size 0x400 — Comparator
0x46007400 VREFBUF size 0x400 — Voltage reference buffer
0x46007800 RTC size 0x400 — Real-time clock
0x46007C00 TAMP size 0x400 — Tamper and backup registers
0x46020000 LPGPIO1 size 0x400
0x46020800 PWR size 0x400 — Power control
0x46020C00 RCC size 0x400 — Reset and clock control
0x46021000 ADC4 size 0x400
0x46021800 DAC1 size 0x400 — Digital-to-analog converter
0x46022000 EXTI size 0x400 — External interrupt/event controller
0x46023000 GTZC2_TZSC size 0x400
0x46023400 GTZC2_TZIC size 0x400
0x46023800 GTZC2_MPCBB4 size 0x400
0x46024000 ADF1 size 0x1000
0x46025000 LPDMA1 size 0x1000
0x50000000 SEC_TIM2 size 0x400
0x50000400 SEC_TIM3 size 0x400
0x50000800 SEC_TIM4 size 0x400
0x50000C00 SEC_TIM5 size 0x400
0x50001000 SEC_TIM6 size 0x400
0x50001400 SEC_TIM7 size 0x400
0x50002C00 SEC_WWDG size 0x400
0x50003000 SEC_IWDG size 0x400
0x50003800 SEC_SPI2 size 0x400
0x50004400 SEC_USART2 size 0x400
0x50004800 SEC_USART3 size 0x400
0x50004C00 SEC_UART4 size 0x400
0x50005000 SEC_UART5 size 0x400
0x50005400 SEC_I2C1 size 0x400
0x50005800 SEC_I2C2 size 0x400
0x50006000 SEC_CRS size 0x400
0x50006400 SEC_USART6 size 0x400
0x50008400 SEC_I2C4 size 0x400
0x50009400 SEC_LPTIM2 size 0x400
0x50009800 SEC_I2C5 size 0x400
0x50009C00 SEC_I2C6 size 0x400
0x5000A400 SEC_FDCAN1 size 0x400
0x5000AC00 SEC_FDCAN1_RAM size 0x400
0x5000DC00 SEC_UCPD1 size 0x400
0x50012C00 SEC_TIM1 size 0x400
0x50013000 SEC_SPI1 size 0x400
0x50013400 SEC_TIM8 size 0x400
0x50013800 SEC_USART1 size 0x400
0x50014000 SEC_TIM15 size 0x400
0x50014400 SEC_TIM16 size 0x400
0x50014800 SEC_TIM17 size 0x400
0x50015400 SEC_SAI1 size 0x400
0x50015800 SEC_SAI2 size 0x400
0x50016400 SEC_GFXTIM size 0x400
0x50016800 SEC_LTDC size 0x400
0x50016C00 SEC_DSI size 0x1000
0x50020000 SEC_GPDMA1 size 0x1000
0x50021000 SEC_CORDIC size 0x400
0x50021400 SEC_FMAC size 0x400
0x50022000 SEC_FLASH size 0x400
0x50023000 SEC_CRC size 0x400
0x50024000 SEC_TSC size 0x400
0x50025000 SEC_MDF1 size 0x1000
0x50026000 SEC_RAMCFG size 0x1000
0x5002A000 SEC_JPEG size 0x1000
0x5002B000 SEC_DMA2D size 0xC00
0x5002C000 SEC_GFXMMU size 0x3000
0x50030400 SEC_ICache size 0x400
0x50031400 SEC_DCACHE1 size 0x400
0x50031800 SEC_DCACHE2 size 0x400
0x50032400 SEC_GTZC1_TZSC size 0x400
0x50032800 SEC_GTZC1_TZIC size 0x400
0x50032C00 SEC_GTZC1_MPCBB1 size 0x400
0x50033000 SEC_GTZC1_MPCBB2 size 0x400
0x50033400 SEC_GTZC1_MPCBB3 size 0x400
0x50033800 SEC_GTZC1_MPCBB5 size 0x400
0x50033C00 SEC_GTZC1_MPCBB6 size 0x400
0x52020000 SEC_GPIOA size 0x400
0x52020400 SEC_GPIOB size 0x400
0x52020800 SEC_GPIOC size 0x400
0x52020C00 SEC_GPIOD size 0x400
0x52021000 SEC_GPIOE size 0x400
0x52021400 SEC_GPIOF size 0x400
0x52021800 SEC_GPIOG size 0x400
0x52021C00 SEC_GPIOH size 0x400
0x52022000 SEC_GPIOI size 0x400
0x52022400 SEC_GPIOJ size 0x400
0x52028000 SEC_ADC1 size 0xCC
0x52028100 SEC_ADC2 size 0xCC
0x52028300 SEC_ADC12_Common size 0x14
0x5202C000 SEC_DCMI size 0x400
0x5202C400 SEC_PSSI size 0x400
0x52040000 SEC_OTG_HS size 0x20000
0x520C0000 SEC_AES size 0x400
0x520C0400 SEC_HASH size 0x400
0x520C0800 SEC_RNG size 0x400
0x520C0C00 SEC_SAES size 0x400
0x520C2000 SEC_PKA size 0x2000
0x520C4000 SEC_OCTOSPIM size 0x400
0x520C5000 SEC_OTFDEC1 size 0x400
0x520C5400 SEC_OTFDEC2 size 0x400
0x520C8000 SEC_SDMMC1 size 0x400
0x520C8400 SEC_DLYBSD1 size 0x400
0x520C8800 SEC_DLYBSD2 size 0x400
0x520C8C00 SEC_SDMMC2 size 0x400
0x520CF000 SEC_DLYBOS1 size 0x400
0x520CF400 SEC_DLYBOS2 size 0x400
0x520D0400 SEC_FMC size 0x400
0x520D1400 SEC_OCTOSPI1 size 0x400
0x520D2400 SEC_OCTOSPI2 size 0x400
0x520D3400 SEC_HSPI1 size 0x400
0x56000400 SEC_SYSCFG size 0x400
0x56002000 SEC_SPI3 size 0x400
0x56002400 SEC_LPUART1 size 0x400
0x56002800 SEC_I2C3 size 0x400
0x56004400 SEC_LPTIM1 size 0x400
0x56004800 SEC_LPTIM3 size 0x400
0x56004C00 SEC_LPTIM4 size 0x400
0x56005000 SEC_OPAMP size 0x400
0x56005400 SEC_COMP size 0x400
0x56007400 SEC_VREFBUF size 0x400
0x56007800 SEC_RTC size 0x400
0x56007C00 SEC_TAMP size 0x400
0x56020000 SEC_LPGPIO1 size 0x400
0x56020800 SEC_PWR size 0x400
0x56020C00 SEC_RCC size 0x400
0x56021000 SEC_ADC4 size 0x400
0x56021800 SEC_DAC1 size 0x400
0x56022000 SEC_EXTI size 0x400
0x56023000 SEC_GTZC2_TZSC size 0x400
0x56023400 SEC_GTZC2_TZIC size 0x400
0x56023800 SEC_GTZC2_MPCBB4 size 0x400
0x56024000 SEC_ADF1 size 0x1000
0x56025000 SEC_LPDMA1 size 0x1000
0xE000EE08 DCB size 0x5 — Debug Control Block
0xE0044000 DBGMCU size 0x1000 — MCU debug component

## Interrupts
0 WWDG — Window Watchdog interrupt
1 PVD_PVM (EXTI) — Power voltage monitor/Analog voltage monitor
2 RTC — RTC global non-secure interrupts
3 RTC_S (RTC) — RTC global secure interrupts
4 TAMP — Tamper global interrupts
5 RAMCFG — RAM configuration global interrupt
6 FLASH — Flash memory non-secure global interrupt
7 FLASH_S (FLASH) — Flash memory secure global interrupt
8 GTZC (GTZC1_MPCBB1) — GTZC1/GTZC2 global interrupt
9 RCC — RCC non-secure global interrupt
10 RCC_S (RCC) — RCC secure global interrupt
{n+11} EXTI{n} (EXTI) (n=0..15) — EXTI line{n} interrupt
27 IWDG — Independent watchdog interrupt
28 SAES — Secure AES
{n+29} GPDMA1_CHannel{n} (GPDMA1) (n=0..7) — GPDMA1 channel {n} global interrupt
37 ADC12 (ADC1) — ADC1 (14 bits) global interrupt
38 DAC1 — DAC1 global interrupt
39 FDCAN1_IT0 (FDCAN1_RAM) — FDCAN1 Interrupt 0
40 FDCAN1_IT1 (FDCAN1_RAM) — FDCAN1 Interrupt 1
41 TIM1_BRK (TIM1) — TIM1 Break - transition error -index error
42 TIM1_UP (TIM1) — TIM1 Update
43 TIM1_TRG_COM (TIM1) — TIM1 Trigger and Commutation - direction change interrupt -index
44 TIM1_CC (TIM1) — TIM1 Capture Compare interrupt
45 TIM2 — TIM2 global interrupt
46 TIM3 — TIM3 global interrupt
47 TIM4 — TIM4 global interrupt
48 TIM5 — TIM5 global interrupt
49 TIM6 — TIM6 global interrupt
50 TIM7 — TIM7 global interrupt
51 TIM8_BRK (TIM8) — TIM8 Break Interrupt
52 TIM8_UP (TIM8) — TIM8 Update Interrupt
53 TIM8_TRG_COM (TIM8) — TIM8 Trigger and Commutation Interrupt
54 TIM8_CC (TIM8) — TIM8 Capture Compare Interrupt
55 I2C1_EV (I2C1) — I2C1 event interrupt
56 I2C1_ER (I2C1) — I2C1 error interrupt
57 I2C2_EV (I2C2) — I2C2 event interrupt
58 I2C2_ER (I2C2) — I2C2 error interrupt
59 SPI1 — SPI1 global interrupt
60 SPI2 — SPI2 global interrupt
61 USART1 — USART1 global interrupt
62 USART2 — USART2 global interrupt
63 USART3 — USART3 global interrupt
64 UART4 — UART4 global interrupt
65 UART5 — UART5 global interrupt
66 LPUART1 — LPUART1 global interrupt
67 LPTIM1 — LPTIM1 global interrupt
68 LPTIM2 — LPTIM2 global interrupt
69 TIM15 — TIM15 global interrupt
70 TIM16 — TIM16 global interrupt
71 TIM17 — TIM17 global interrupt
72 COMP — COMP1 and COMP2 interrupts
73 OTG_HS — USB OTG global interrupt
74 CRS — Clock recovery system global interrupt
75 FMC — FMC global interrupt
76 OCTOSPI1 — OCTOSPI1 global interrupt
77 PWR_S3WU (PWR) — PWR wakeup from Stop 3 interrupt
78 SDMMC1 — SDMMC1 global interrupt
79 SDMMC2 — SDMMC2 global interrupt
{n+72} GPDMA1_CHannel{n} (GPDMA1) (n=8..15) — GPDMA1 channel {n} global interrupt
88 I2C3_EV (I2C3) — I2C3 event interrupt
89 I2C3_ER (I2C3) — I2C3 error interrupt
90 SAI1 — SAI1 global interrupt
91 SAI2 — SAI2 global interrupt
92 TSC — TSC global interrupt
93 AES — AES global interrupt
94 RNG — RNG global interrupt
95 FPU (EXTI) — Floating point interrupt
96 HASH — HASH interrupt
97 PKA — PKA global interrupt
98 LPTIM3 — LPTIM3 global interrupt
99 SPI3 — SPI3 global interrupt
100 I2C4_ER (I2C4) — I2C4 error interrupt
101 I2C4_EV (I2C4) — I2C4 event interrupt
102 MDF1_FLT0 (MDF1) — MDF1 filter 0 global interrupt
103 MDF1_FLT1 (MDF1) — MDF1 filter 1 global interrupt
104 MDF1_FLT2 (MDF1) — MDF1 filter 2 global interrupt
105 MDF1_FLT3 (MDF1) — MDF1 filter 3 global interrupt
106 UCPD1 — UCPD1 global interrupt
107 ICACHE (ICache) — Instruction cache global interrupt
108 OTFDEC1 — OTFDEC1 secure global interrupt
109 OTFDEC2 — OTFDEC2 secure global interrupt
110 LPTIM4 — LPTIM4 global interrupt
111 DCACHE1 — Data cache global interrupt
112 ADF1_FLT0 (ADF1) — ADF1 filter 0 global interrupt
113 ADC4 — ADC4 (12 bits) global interrupt
114 LPDMA1_CH0 (LPDMA1) — LPDMA1 SmartRun channel 0 global interrupt
115 LPDMA1_CH1 (LPDMA1) — LPDMA1 SmartRun channel 1 global interrupt
116 LPDMA1_CH2 (LPDMA1) — LPDMA1 SmartRun channel 2 global interrupt
117 LPDMA1_CH3 (LPDMA1) — LPDMA1 SmartRun channel 3 global interrupt
118 DMA2D — DMA2D global interrupt
119 DCMI_PSSI (DCMI) — DCMI/PSSI global interrupt
120 OCTOSPI2 — OCTOSPI2 global interrupt
121 MDF1_FLT4 (MDF1) — MDF1 filter 4 global interrupt
122 MDF1_FLT5 (MDF1) — MDF1 filter 5 global interrupt
123 CORDIC — CORDIC interrupt
124 FMAC — FMAC interrupt
125 LSECSSD (EXTI) — LSECSSD interrupt
126 USART6 — USART6 global interrupt
127 I2C5_ER (I2C5) — I2C5 error interrupt
128 I2C5_EV (I2C5) — I2C5 event interrupt
129 I2C6_ER (I2C6) — I2C6 error interrupt
130 I2C6_EV (I2C6) — I2C6 event interrupt
131 HSPI1 — Hexadeca-SPI1 global interrupt
132 GPU2D (EXTI) — GPU2D interrupt
133 GPU2D_ER (EXTI) — GPU2D system interrupt
134 GFXMMU — GFXMMU global error interrupt
135 LCD_TFT (LTDC) — LTDC global interrupt
136 LCD_TFT_ERR (LTDC) — LTDC global error interrupt
137 DSIHOST (DSI) — DSI global interrupt
138 DCACHE2 — Data cache 2 global interrupt
139 GFXTIM — GFXTIM global interrupt
140 JPEG — JPEG sync interrupt
